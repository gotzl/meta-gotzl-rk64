## conf/layer.conf
```bitbake
# We have a conf and classes directory, add to BBPATH
BBPATH .= ":${LAYERDIR}"

# We have recipes-* directories, add to BBFILES
BBFILES += "${LAYERDIR}/recipes-*/*/*.bb \
            ${LAYERDIR}/recipes-*/*/*.bbappend"

BBFILE_COLLECTIONS += "meta-gotzl-rk64"
BBFILE_PATTERN_meta-gotzl-rk64 = "^${LAYERDIR}/"
BBFILE_PRIORITY_meta-gotzl-rk64 = "11"

LAYERDEPENDS_meta-gotzl-rk64 = "core"
LAYERSERIES_COMPAT_meta-gotzl-rk64 = "zeus dunfell"
```
